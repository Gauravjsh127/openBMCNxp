## meta-evb/meta-evb-nxp/conf/layer.conf
```bitbake
# We have a conf and classes directory, add to BBPATH
BBPATH .= ":${LAYERDIR}"

BBFILE_COLLECTIONS += "evb-nxp"
BBFILE_PATTERN_evb-nxp = ""
LAYERSERIES_COMPAT_evb-nxp = "thud"
```

## meta-evb/meta-evb-nxp/meta-evb-LS1021ATWR/conf/layer.conf
```bitbake
# We have a conf and classes directory, add to BBPATH
BBPATH .= ":${LAYERDIR}"

BBFILE_COLLECTIONS += "evb-LS1021ATWR"
BBFILE_PATTERN_evb-LS1021ATWR = ""
LAYERSERIES_COMPAT_evb-LS1021ATWR = "sumo"
```

## meta-evb/meta-evb-nxp/meta-evb-LS1021ATWR/conf/local.conf.sample
```bitbake
MACHINE ??= "ls1021atwr"
DISTRO ?= "openbmc-phosphor"
PACKAGE_CLASSES ?= "package_rpm"
SANITY_TESTED_DISTROS_append ?= " *"
EXTRA_IMAGE_FEATURES = "debug-tweaks"
USER_CLASSES ?= "buildstats image-mklibs image-prelink"
PATCHRESOLVE = "noop"
BB_DISKMON_DIRS = "\
    STOPTASKS,${TMPDIR},1G,100K \
    STOPTASKS,${DL_DIR},1G,100K \
    STOPTASKS,${SSTATE_DIR},1G,100K \
    STOPTASKS,/tmp,100M,100K \
    ABORT,${TMPDIR},100M,1K \
    ABORT,${DL_DIR},100M,1K \
    ABORT,${SSTATE_DIR},100M,1K \
    ABORT,/tmp,10M,1K"
CONF_VERSION = "1"
INHERIT += "extrausers"
EXTRA_USERS_PARAMS = " useradd openbmc; \
                       usermod  -p 'openbmc' openbmc; \
                       usermod  -a -G sudo openbmc;"

ACCEPT_FSL_EULA = "1"

IMAGE_FSTYPES = "cpio.gz"

IMAGE_INSTALL_append = "kernel-image-uimage kernel-image  "

IMAGE_INSTALL_append = "kernel-dev "

IMAGE_INSTALL_append = "kernel-vmlinux "

IMAGE_INSTALL_append = "kernel-devicetree "

IMAGE_INSTALL_append = "images "

################ Drivers ############################################
##1 fsptrace ######
IMAGE_INSTALL_append = "fsptrace "

IMAGE_INSTALL_append = "trace-cmd "


##2 IBM utils ######
IMAGE_INSTALL_append +="ibmutils"


##3 ngfsi ######
IMAGE_INSTALL_append +="ngfsi"



################ ADALS ############################################

## ADAL Header files ######
IMAGE_INSTALL_append += "adal-headerfiles adal-headerfiles-dev "

## 1 fsptrace ######
IMAGE_INSTALL_append +="fsptrace-adal fsptrace-adal-staticdev fsptrace-adal-dev fsptrace-adal-dbg "
IMAGE_INSTALL_append +="libtrex libtrex-dev libtrex-dbg "

##2 SCAN ######
IMAGE_INSTALL_append += "scan-adal scan-adal-dev scan-adal-dbg "

##3 SCOM ######
IMAGE_INSTALL_append += "scom-adal scom-adal-dev scom-adal-dbg "

##4 BASE ######
IMAGE_INSTALL_append += "base-adal base-adal-dev base-adal-dbg "

##5 FSI ######
IMAGE_INSTALL_append += "fsi-adal fsi-adal-dev fsi-adal-dbg  "

##6 IOMUX ######
IMAGE_INSTALL_append += "iomux-adal iomux-adal-dev iomux-adal-dbg "

##7 dd-ddfc ######
IMAGE_INSTALL_append += "dd-ffdc-adal dd-ffdc-adal-dev dd-ffdc-adal-dbg "

##8 PSI ######
IMAGE_INSTALL_append += "psi-adal psi-adal-dev psi-adal-dbg "

##9 IIC ######
#IMAGE_INSTALL_append += "iic-master-adal iic-master-adal-dev iic-master-adal-dbg "
#IMAGE_INSTALL_append += "iic-slave-adal iic-slave-adal-dev iic-slave-adal-dbg "

##10 mbx ######
IMAGE_INSTALL_append += "mbx-adal mbx-adal-dev mbx-adal-dbg "

##11 PCI ######
IMAGE_INSTALL_append += "pci-adal pci-adal-dev pci-adal-dbg "

##12 RTC ######
IMAGE_INSTALL_append += "rtc-adal rtc-adal-dev rtc-adal-dbg "

##13 Scratchpad ######
IMAGE_INSTALL_append += "scratchpad-adal scratchpad-adal-dev scratchpad-adal-dbg "

##14 Tone ######
IMAGE_INSTALL_append += "tone-adal tone-adal-dev tone-adal-dbg "

##15 SFC ######
IMAGE_INSTALL_append += "sfc-adal sfc-adal-dev sfc-adal-dbg "

##16 Hostdma ######
IMAGE_INSTALL_append += "hostdma-adal hostdma-adal-dev hostdma-adal-dbg "

##17 UART ######
IMAGE_INSTALL_append += "uart-adal uart-adal-dev uart-adal-dbg "

##18 JTAG ######
IMAGE_INSTALL_append += "jtag-adal jtag-adal-dev jtag-adal-dbg "

##19 GPIO ######
IMAGE_INSTALL_append += "gpio-adal gpio-adal-dev gpio-adal-dbg  "

##20 GPIO ######
IMAGE_INSTALL_append += "lua-bbutils-adal lua-bbutils-adal-dev lua-bbutils-adal-dbg "

##21 PCI ######
IMAGE_INSTALL_append += "pci-adal pci-adal-dev pci-adal-dbg "

##22 SBEFIFO ######
IMAGE_INSTALL_append += "sbefifo-adal sbefifo-adal-dev sbefifo-adal-dbg "

################ APPS ############################################

## 1 fsptrace ######
IMAGE_INSTALL_append +="fsp-trace libtrex "


################ openBMC packages ############################################

IMAGE_INSTALL_append += " crash "

#IMAGE_INSTALL_append += " grpc grpc-dev grpc-dbg "

IMAGE_INSTALL_append += " zeromq zeromq-dev zeromq-dbg "

IMAGE_INSTALL_append += " sqlite3 sqlite3-dbg "

IMAGE_INSTALL_append += " fuse fuse-dev fuse-dbg  "

IMAGE_INSTALL_append += " libtirpc libtirpc-dev libtirpc-dbg "

IMAGE_INSTALL_append += "rpcbind rpcbind-dev rpcbind-dbg "

IMAGE_INSTALL_append = " kernel-modules "

EXTRA_IMAGE_FEATURES += " tools-debug"

IMAGE_INSTALL_append +=" libatomic libatomic procps "

IMAGE_INSTALL_append += " libstdc++ "

IMAGE_INSTALL_append += " kmod kmod-dbg rpm rpm-dbg "

IMAGE_INSTALL_append += " makedumpfile makedumpfile-dev makedumpfile-dbg "

IMAGE_INSTALL_append += " lua acl   "

#IMAGE_INSTALL_append += " openldap openldap-dev "

IMAGE_INSTALL_append += " libidn gmp nettle libcap libcap-dbg "

IMAGE_INSTALL_append += " libgpg-error libgpg-error-dbg libgcrypt  libgcrypt-dbg "

IMAGE_INSTALL_append += " libpam pam-plugin-succeed-if pam-plugin-access libpam-dbg "

IMAGE_INSTALL_append += " net-snmp net-snmp-dev net-snmp-dbg "

IMAGE_INSTALL_append += "openssh openssh-dev openssh-dbg "

IMAGE_INSTALL_append += "util-linux util-linux-dev util-linux-dbg "

IMAGE_INSTALL_append += " tcpdump tcpdump-dev tcpdump-dbg "

IMAGE_INSTALL_append += " pciutils pciutils-dev pciutils-dbg "

IMAGE_INSTALL_append += "net-tools net-tools-dev net-tools-dbg "

IMAGE_INSTALL_append += "krb5 krb5-dev krb5-dbg "

IMAGE_INSTALL_append += "xz xz-dev xz-dbg "

IMAGE_INSTALL_append += "lua lua-dev lua-dbg "

IMAGE_INSTALL_append += "libbz2 "

IMAGE_INSTALL_append += "elfutils elfutils-dev elfutils-dbg "

IMAGE_INSTALL_append += "libcap-ng libcap-ng-dev libcap-ng-dbg "

IMAGE_INSTALL_append += "libxml2 libxml2-dbg liburcu liburcu-dbg "

IMAGE_INSTALL_append += "ifenslave ethtool "

IMAGE_INSTALL_append += "udev "

################ Debug packages ############################################

IMAGE_INSTALL_append +="netcat "

IMAGE_INSTALL_append += "glibc-dbg " 

IMAGE_INSTALL_append +="lttng-ust "

IMAGE_INSTALL_append +="babeltrace babeltrace-dev"

IMAGE_INSTALL_append +="lttng-tools lttng-tools-dev "

IMAGE_INSTALL_append +="lttng-modules lttng-modules-dev "

################ kdump/kexec packages ############################################

IMAGE_INSTALL_append +=" kexec-tools kexec-tools-dev kexec-tools-dbg "

################ FSI DD test package ############################################
IMAGE_INSTALL_append +="gpcm2fsi "

IMAGE_INSTALL_append +="trace-collect "
```

## meta-evb/meta-evb-nxp/meta-evb-x86/conf/bblayers.conf.sample
```bitbake
# LAYER_CONF_VERSION is increased each time build/conf/bblayers.conf
# changes incompatibly
LCONF_VERSION = "8"

BBPATH = "${TOPDIR}"
BBFILES ?= ""

BBLAYERS ?= " \
  ##OEROOT##/meta \
  ##OEROOT##/meta-poky \
  ##OEROOT##/meta-openembedded/meta-filesystems/   \
  ##OEROOT##/meta-openembedded/meta-oe \
  ##OEROOT##/meta-openembedded/meta-networking \
  ##OEROOT##/meta-openembedded/meta-python \
  ##OEROOT##/meta-openembedded/meta-webserver \
  ##OEROOT##/meta-phosphor \
  ##OEROOT##/meta-freescale \
  ##OEROOT##/meta-evb \
  ##OEROOT##/meta-evb/meta-evb-nxp \
  ##OEROOT##/meta-evb/meta-evb-nxp/meta-evb-x86 \
  ##OEROOT##/meta-openbmc-bsp/meta-ibm/meta-fsp2 \
  ##OEROOT##/meta-openbmc-bsp/meta-ibm/meta-ibm-internal-nxp/meta-fsp2-drivers \
  ##OEROOT##/meta-openbmc-bsp/meta-ibm/meta-ibm-internal-nxp/meta-fsp2-adals \
  ##OEROOT##/meta-openbmc-bsp/meta-ibm/meta-ibm-internal-nxp/meta-fsp2-apps \  
  ##OEROOT##/meta-openbmc-bsp/meta-ibm/meta-ibm-internal-nxp/meta-fsp2-boot \
  "
BBLAYERS_NON_REMOVABLE ?= " \
  ##OEROOT##/meta \
  ##OEROOT##/meta-poky \
  ##OEROOT##/meta-openembedded/meta-oe \
  ##OEROOT##/meta-openembedded/meta-networking \
  ##OEROOT##/meta-openembedded/meta-python \
  ##OEROOT##/meta-phosphor \
  ##OEROOT##/meta-nuvoton \
  ##OEROOT##/meta-evb \
  ##OEROOT##/meta-evb/meta-evb-nxp \
  "
```

## meta-evb/meta-evb-nxp/meta-evb-x86/conf/layer.conf
```bitbake
# We have a conf and classes directory, add to BBPATH
BBPATH .= ":${LAYERDIR}"

BBFILE_COLLECTIONS += "evb-x86"
BBFILE_PATTERN_evb-x86 = ""
LAYERSERIES_COMPAT_evb-x86 = "sumo"
```

## meta-freescale/conf/machine/evb-x86.conf
```bitbake
#@TYPE: Machine
#@DESCRIPTION: Machine configuration for running 

TARGET_FPU = ""

COMPATIBLE_MACHINE_evb-x86 = "evb-x86"

DEFAULTTUNE ?= "x86-64"
require conf/machine/include/x86/arch-x86.inc

SERIAL_CONSOLE = "115200 ttyS0"

MACHINE_FEATURES = "keyboard pci ext2 ext3 serial"
PREFERRED_PROVIDER_virtual/xserver ?= "xserver-xorg"
XSERVER ?= "xserver-xorg \
            xf86-video-fbdev"

KERNEL_DEVICETREE = "${KMACHINE}-npcm750-evb.dtb"
MACHINE_EXTRA_RRECOMMENDS = " kernel-modules"

UBOOT_ENTRYPOINT = "0x01400000"
IMAGE_FSTYPES ?= "cpio.gz"

MACHINE_FEATURES += "x86"

BASELIB ??="lib64"
```
